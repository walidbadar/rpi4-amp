## CMakeLists.txt
```
# SPDX-FileCopyrightText: 2026 Muhammad Waleed Badar
# SPDX-License-Identifier: Apache-2.0

cmake_minimum_required(VERSION 3.20.0)

list(APPEND EXTRA_CONF_FILE ${CMAKE_CURRENT_LIST_DIR}/../../common/amp.conf)

find_package(Zephyr REQUIRED HINTS $ENV{ZEPHYR_BASE})
project(rpi4_amp_hello)

target_sources(app PRIVATE src/main.c)
```

## prj.conf
```kconfig
# SPDX-FileCopyrightText: 2026 Muhammad Waleed Badar
# SPDX-License-Identifier: Apache-2.0

CONFIG_PRINTK=y

# Console in shared memory, read from Linux
CONFIG_RAM_CONSOLE=y
```

## boards/rpi_4b.overlay
```dts
/*
 * SPDX-FileCopyrightText: 2026 Muhammad Waleed Badar
 * SPDX-License-Identifier: Apache-2.0
 */

#include "../../../common/rpi_4b_amp.dtsi"
```

## src/main.c
```c
/*
 * SPDX-FileCopyrightText: 2026 Muhammad Waleed Badar
 * SPDX-License-Identifier: Apache-2.0
 */

#include <zephyr/kernel.h>
#include <zephyr/sys/printk.h>
#include <zephyr/arch/arm64/lib_helpers.h>

int main(void)
{
	uint32_t count = 0U;

	printk("Zephyr AMP on MPIDR 0x%llx\n", read_mpidr_el1());

	while (true) {
		printk("alive %u, uptime %lld ms\n", count++, k_uptime_get());
		k_sleep(K_SECONDS(1));
	}

	return 0;
}
```
